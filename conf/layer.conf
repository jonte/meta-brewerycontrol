## conf/layer.conf
```bitbake
# We have a conf and classes directory, add to BBPATH
BBPATH .= ":${LAYERDIR}"

# We have recipes-* directories, add to BBFILES
BBFILES += "${LAYERDIR}/recipes-*/*/*.bb \
            ${LAYERDIR}/recipes-*/*/*.bbappend"

BBFILE_COLLECTIONS += "meta-brewerycontrol"
BBFILE_PATTERN_meta-brewerycontrol = "^${LAYERDIR}/"
BBFILE_PRIORITY_meta-brewerycontrol = "8"

LAYERDEPENDS_meta-brewerycontrol = "core"
LAYERSERIES_COMPAT_meta-brewerycontrol = "warrior"
```
